## build/Kconfig/arch/Kconfig
```kconfig
# Load Zephyr Arch Kconfig descriptions.
osource "/home/pecosdwilly/zephyrproject/zephyr/arch/rx/Kconfig"
osource "/home/pecosdwilly/zephyrproject/zephyr/arch/x86/Kconfig"
osource "/home/pecosdwilly/zephyrproject/zephyr/arch/xtensa/Kconfig"
osource "/home/pecosdwilly/zephyrproject/zephyr/arch/sparc/Kconfig"
osource "/home/pecosdwilly/zephyrproject/zephyr/arch/riscv/Kconfig"
osource "/home/pecosdwilly/zephyrproject/zephyr/arch/posix/Kconfig"
osource "/home/pecosdwilly/zephyrproject/zephyr/arch/mips/Kconfig"
osource "/home/pecosdwilly/zephyrproject/zephyr/arch/arm64/Kconfig"
osource "/home/pecosdwilly/zephyrproject/zephyr/arch/arm/Kconfig"
osource "/home/pecosdwilly/zephyrproject/zephyr/arch/arc/Kconfig"
```

## build/Kconfig/boards/Kconfig
```kconfig
# Load Zephyr board Kconfig descriptions.
osource "/home/pecosdwilly/zephyrproject/zephyr/boards/arduino/uno_q/Kconfig"
```

## build/Kconfig/boards/Kconfig.defconfig
```kconfig
# Load Zephyr board defconfig descriptions.
osource "/home/pecosdwilly/zephyrproject/zephyr/boards/arduino/uno_q/Kconfig.defconfig"
```

## build/Kconfig/boards/Kconfig.rpi_pico2
```kconfig
# Load board Kconfig descriptions.
osource "/home/pecosdwilly/zephyrproject/zephyr/boards/raspberrypi/rpi_pico2/Kconfig.rpi_pico2"
```

## zephyr_d16_app/build/Kconfig/boards/Kconfig
```kconfig
# Load Zephyr board Kconfig descriptions.
osource "/home/pecosdwilly/zephyrproject/zephyr/boards/arduino/uno_r4/Kconfig"
config BOARD_REVISION_WIFI
	def_bool y
```

## zephyr_d16_app/build/Kconfig/boards/Kconfig.arduino_uno_r4
```kconfig
# Load board Kconfig descriptions.
osource "/home/pecosdwilly/zephyrproject/zephyr/boards/arduino/uno_r4/Kconfig.arduino_uno_r4"
```

## zephyr_d16_app/build/Kconfig/boards/Kconfig.defconfig
```kconfig
# Load Zephyr board defconfig descriptions.
osource "/home/pecosdwilly/zephyrproject/zephyr/boards/arduino/uno_r4/Kconfig.defconfig"
```

## zephyr_d16_app/build/Kconfig/boards/Kconfig.sysbuild
```kconfig
# Load Sysbuild board Kconfig descriptions.
osource "/home/pecosdwilly/zephyrproject/zephyr/boards/arduino/uno_r4/Kconfig.sysbuild"
```
